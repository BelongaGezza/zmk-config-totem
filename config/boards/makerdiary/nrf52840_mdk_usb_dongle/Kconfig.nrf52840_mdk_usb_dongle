## config/boards/makerdiary/nrf52840_mdk_usb_dongle/Kconfig.nrf52840_mdk_usb_dongle
```kconfig
# Copyright (c) 2026 The ZMK Contributors
# SPDX-License-Identifier: MIT

# Selects ZMK_BOARD_COMPAT when building the //zmk variant, satisfying ZMK's
# board compatibility requirement.  Symbol name must match Zephyr's upstream
# BOARD_NRF52840_MDK_USB_DONGLE (boards/makerdiary/nrf52840_mdk_usb_dongle/Kconfig.nrf52840_mdk_usb_dongle).

config BOARD_NRF52840_MDK_USB_DONGLE
	select ZMK_BOARD_COMPAT if BOARD_NRF52840_MDK_USB_DONGLE_NRF52840_ZMK
```

## config/boards/makerdiary/nrf52840_mdk_usb_dongle/board.yml
```yaml
# ZMK board extension for the Makerdiary nRF52840 MDK USB Dongle.
#
# Extends the Zephyr upstream board definition (boards/makerdiary/nrf52840_mdk_usb_dongle)
# with a //zmk variant, enabling ZMK's compat check and build system to accept this board.
#
# Reference: app/boards/nordic/nrf52840dongle/board.yml in zmkfirmware/zmk

board:
  extend: nrf52840_mdk_usb_dongle
  variants:
    - name: zmk
      qualifier: nrf52840
```

## config/boards/makerdiary/nrf52840_mdk_usb_dongle/nrf52840_mdk_usb_dongle_nrf52840_zmk_defconfig
```kconfig
# Copyright (c) 2026 The ZMK Contributors
# SPDX-License-Identifier: MIT
#
# ZMK defconfig for the Makerdiary nRF52840 MDK USB Dongle //zmk variant.
# Mirrors nrf52840dongle_nrf52840_zmk_defconfig from zmkfirmware/zmk with
# additions specific to Makerdiary hardware.

# Core
CONFIG_ARM_MPU=y
CONFIG_HW_STACK_PROTECTION=y
CONFIG_GPIO=y

# HID transports — dongle outputs USB to host, BLE to keyboard halves
CONFIG_ZMK_USB=y
CONFIG_ZMK_BLE=y

# USB remote wakeup: disabled to avoid conflict with nrfx USB driver implication
CONFIG_USB_DEVICE_REMOTE_WAKEUP=n

# Settings / bond storage (NVS at storage_partition = 0xcc000 per fstab-stock)
CONFIG_MPU_ALLOW_FLASH_WRITE=y
CONFIG_NVS=y
CONFIG_SETTINGS_NVS=y
CONFIG_FLASH=y
CONFIG_FLASH_PAGE_LAYOUT=y
CONFIG_FLASH_MAP=y

# Generate UF2 output — Makerdiary MDK USB Dongle uses a UF2 bootloader
CONFIG_BUILD_OUTPUT_UF2=y
```

## config/boards/shields/totem/Kconfig.defconfig
```kconfig
# Copyright (c) 2022 The ZMK Contributors
# SPDX-License-Identifier: MIT

# ── Mode 2/3+: Left half is the BLE central ─────────────────────────────────

if SHIELD_TOTEM_LEFT

config ZMK_KEYBOARD_NAME
    default "TOTEM"

config ZMK_SPLIT_ROLE_CENTRAL
    default y

endif

# ── Mode 1: Dongle is the USB central ───────────────────────────────────────

if SHIELD_TOTEM_DONGLE

config ZMK_KEYBOARD_NAME
    default "TOTEM"

config ZMK_SPLIT_ROLE_CENTRAL
    default y

# Two peripheral BLE connections (left + right halves) plus up to one host BLE
# pairing = 3 total.  USB is the primary HID output for the dongle, but BLE
# must remain enabled for peripheral communication.
config BT_MAX_CONN
    default 3

config BT_MAX_PAIRED
    default 3

# Tell ZMK's split stack to wait for two peripherals before reporting ready.
config ZMK_SPLIT_BLE_CENTRAL_PERIPHERALS
    default 2

endif

# ── All split roles need ZMK_SPLIT enabled ───────────────────────────────────

if SHIELD_TOTEM_LEFT || SHIELD_TOTEM_RIGHT || SHIELD_TOTEM_DONGLE || SHIELD_TOTEM_LEFT_PERIPHERAL

config ZMK_SPLIT
    default y

endif
```

## config/boards/shields/totem/Kconfig.shield
```kconfig
# Copyright (c) 2022 The ZMK Contributors
# SPDX-License-Identifier: MIT

# ── Mode 2/3+: left-as-central split ────────────────────────────────────────
config SHIELD_TOTEM_LEFT
    def_bool $(shields_list_contains,totem_left)

config SHIELD_TOTEM_RIGHT
    def_bool $(shields_list_contains,totem_right)

# ── Mode 1: dongle-as-central split ─────────────────────────────────────────
config SHIELD_TOTEM_DONGLE
    def_bool $(shields_list_contains,totem_dongle)

config SHIELD_TOTEM_LEFT_PERIPHERAL
    def_bool $(shields_list_contains,totem_left_peripheral)
```

## config/west.yml
```yaml
manifest:
  remotes:
    - name: zmkfirmware
      url-base: https://github.com/zmkfirmware
  projects:
    - name: zmk
      remote: zmkfirmware
      # Updated from v0.3 to main — required for nrf52840_mdk_usb_dongle board
      # support and the 3-board dongle split improvements. Main is rolling and
      # may occasionally be unstable; pin to a specific commit hash if you need
      # reproducible builds.
      revision: main
      import: app/west.yml
  self:
    path: config
```
